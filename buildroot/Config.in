## buildroot/Config.in
```kconfig
source "../package/geographiclib/Config.in"
source "../package/lk8000websrv/Config.in"
```

## buildroot/package/gattlib/Config.in
```kconfig
config BR2_PACKAGE_GATTLIB
	bool "gattlib"
	depends on BR2_INSTALL_LIBSTDCPP
	depends on BR2_TOOLCHAIN_HAS_THREADS
	select BR2_PACKAGE_BLUEZ5_UTILS
	select BR2_PACKAGE_DBUS
	select BR2_PACKAGE_LIBGLIB2
	help
	  Gattlib is a C library to access Bluetooth Low Energy (BLE) GATT
	  characteristics, talking to BlueZ over its D-Bus API.

	  Not packaged in mainline Buildroot; added here for LK8000's
	  optional BLE: device support (Comm/Bluetooth/BlueZGattSensor),
	  pkg-config name "gattlib".

	  https://github.com/labapart/gattlib

comment "gattlib needs a toolchain w/ C++ and threads"
	depends on !BR2_INSTALL_LIBSTDCPP || !BR2_TOOLCHAIN_HAS_THREADS
```

## buildroot/package/geographiclib/Config.in
```kconfig
config BR2_PACKAGE_GEOGRAPHICLIB
	bool "geographiclib"
	depends on BR2_INSTALL_LIBSTDCPP
	help
	  GeographicLib is a small C++ library for geographic
	  projections, geodesic calculations, and other operations
	  on an ellipsoid of revolution.

	  Not packaged in mainline Buildroot; added here for LK8000,
	  which links against it (geographiclib::geographiclib /
	  pkg-config geographiclib) for WGS84 geodesic distance and
	  bearing calculations.

	  https://geographiclib.sourceforge.io/

comment "geographiclib needs a toolchain w/ C++"
	depends on !BR2_INSTALL_LIBSTDCPP
```

## buildroot/package/lk8000websrv/Config.in
```kconfig
config BR2_PACKAGE_LK8000WEBSRV
	bool "lk8000websrv"
	depends on BR2_TOOLCHAIN_HAS_THREADS
	depends on BR2_USE_MMU # civetweb needs fork()
	select BR2_PACKAGE_CIVETWEB
	select BR2_PACKAGE_CIVETWEB_LIB
	help
	  LK8000WebSrv is a small HTTP server built on civetweb (embedded,
	  not the standalone civetweb server app) that lets a Kobo device
	  serve its Logger trace files and Task files for browsing,
	  download, upload, and deletion over the network.

	  LK8000-specific: not a standalone upstream project. Built from
	  source shipped in-tree at Scripts/externals/LK8000WebSrv (this
	  package's SITE points there via the "local" site method) rather
	  than fetched from a URL.

comment "lk8000websrv needs a toolchain w/ threads"
	depends on BR2_USE_MMU
	depends on !BR2_TOOLCHAIN_HAS_THREADS
```
